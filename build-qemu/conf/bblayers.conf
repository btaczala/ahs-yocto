## build-qemu/conf/bblayers.conf
```bitbake
# POKY_BBLAYERS_CONF_VERSION is increased each time build/conf/bblayers.conf
# changes incompatibly
POKY_BBLAYERS_CONF_VERSION = "2"

BBPATH = "${TOPDIR}"
BBFILES ?= ""

BBLAYERS ?= " \
  /home/jenkins/shared/poky/meta \
  /home/jenkins/shared/poky/meta-poky \
  /home/jenkins/shared/poky/meta-yocto-bsp \
  /home/jenkins/shared//meta-ivi/meta-ivi \
  /home/jenkins/shared//meta-qt5 \
  /home/jenkins/shared//meta-openembedded/meta-oe \
  "
```

## build-qemu/conf/local.conf
```bitbake
LICENSE_FLAGS_WHITELIST = "commercial"
DISTRO_FEATURES = "systemd wayland x11 pulseaudio opengl ${DISTRO_FEATURES_LIBC}"

MACHINE ?= "qemux86-64"
VIRTUAL-RUNTIME_init_manager = "systemd"
DISTRO ?= "poky"
# Options are:
#  - 'package_deb' for debian style deb files
#  - 'package_ipk' for ipk files are used by opkg (a debian style embedded package manager)
#  - 'package_rpm' for rpm style packages
# E.g.: PACKAGE_CLASSES ?= "package_rpm package_deb package_ipk"
# We default to rpm:
PACKAGE_CLASSES ?= "package_ipk"

#
# SDK target architecture
#
# This variable specifies the architecture to build SDK items for and means
# you can build the SDK packages for architectures other than the machine you are
# running the build on (i.e. building i686 packages on an x86_64 host).
# Supported values are i686 and x86_64
SDKMACHINE ?= "x86_64"
EXTRA_IMAGE_FEATURES ?= "debug-tweaks"

USER_CLASSES ?= "buildstats image-mklibs image-prelink"
PATCHRESOLVE = "noop"

BB_DISKMON_DIRS = "\
    STOPTASKS,${TMPDIR},1G,100K \
    STOPTASKS,${DL_DIR},1G,100K \
    STOPTASKS,${SSTATE_DIR},1G,100K \
    STOPTASKS,/tmp,100M,100K \
    ABORT,${TMPDIR},100M,1K \
    ABORT,${DL_DIR},100M,1K \
    ABORT,${SSTATE_DIR},100M,1K \
    ABORT,/tmp,10M,1K"

PACKAGECONFIG_append_pn-qemu-native = " sdl"
PACKAGECONFIG_append_pn-nativesdk-qemu = " sdl"
#ASSUME_PROVIDED += "libsdl-native"

RM_OLD_IMAGE = "1"
CORE_IMAGE_EXTRA_INSTALL += "wayland weston"

INHERIT += "rm_work"

CONF_VERSION = "1"
```

## build-rpi3/conf/local.conf
```bitbake
LICENSE_FLAGS_WHITELIST = "commercial"
DISTRO_FEATURES = "wifi systemd wayland pulseaudio opengl ${DISTRO_FEATURES_LIBC}"
DISTRO_FEATURES_remove = "networkd x11"

# This sets the default machine to be qemux86 if no other machine is selected:
MACHINE ??= "raspberrypi3"
VIRTUAL-RUNTIME_init_manager = "systemd"
MACHINE_FEATURES += "vc4graphics"
DISABLE_OVERSCAN = "1"
DISPMANX_OFFLINE = "1"
GPU_MEM = "128"

DISTRO ?= "poky"
# Options are:
#  - 'package_deb' for debian style deb files
#  - 'package_ipk' for ipk files are used by opkg (a debian style embedded package manager)
#  - 'package_rpm' for rpm style packages
# E.g.: PACKAGE_CLASSES ?= "package_rpm package_deb package_ipk"
# We default to rpm:
PACKAGE_CLASSES ?= "package_ipk"

SDKMACHINE ?= "x86_64"
EXTRA_IMAGE_FEATURES ?= "debug-tweaks package-management"
USER_CLASSES ?= "buildstats image-mklibs image-prelink"

PATCHRESOLVE = "noop"

BB_DISKMON_DIRS = "\
    STOPTASKS,${TMPDIR},1G,100K \
    STOPTASKS,${DL_DIR},1G,100K \
    STOPTASKS,${SSTATE_DIR},1G,100K \
    STOPTASKS,/tmp,100M,100K \
    ABORT,${TMPDIR},100M,1K \
    ABORT,${DL_DIR},100M,1K \
    ABORT,${SSTATE_DIR},100M,1K \
    ABORT,/tmp,10M,1K"

# Qemu configuration
#
# By default qemu will build with a builtin VNC server where graphical output can be
# seen. The two lines below enable the SDL backend too. By default libsdl-native will
# be built, if you want to use your host's libSDL instead of the minimal libsdl built
# by libsdl-native then uncomment the ASSUME_PROVIDED line below.
PACKAGECONFIG_append_pn-qemu-native = " sdl"
PACKAGECONFIG_append_pn-nativesdk-qemu = " sdl"

RM_OLD_IMAGE = "1"
INHERIT += "rm_work"

CORE_IMAGE_EXTRA_INSTALL += "networkmanager opkg"
CORE_IMAGE_EXTRA_INSTALL_remove += ""

CONF_VERSION = "1"
```

## meta-rpi-custom/conf/layer.conf
```bitbake
# We have a conf and classes directory, add to BBPATH
BBPATH =. "${LAYERDIR}:"

# We have recipes-* directories, add to BBFILES
BBFILES += "${LAYERDIR}/recipes-*/*/*.bb \
            ${LAYERDIR}/recipes-*/*/*.bbappend"

BBFILE_COLLECTIONS += "rpi-custom-layer"
BBFILE_PATTERN_rpi-custom-layer = "^${LAYERDIR}/"
BBFILE_PRIORITY_rpi-custom-layer-append = "8"

# This should only be incremented on significant changes that will
# cause compatibility issues with other layers
LAYERVERSION_rpi-custom-layer-append = "1"
LAYERDEPENDS_rpi-custom-layer-append = "qt5-layer"
```
